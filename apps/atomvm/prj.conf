## CMakeLists.txt
```
# AtomVM for the Tang Primer 25K LiteX SoC: AtomVM's Zephyr port (src/platforms/zephyr of the
# pinned checkout, plus patches/atomvm) with this board's configuration and AVM pack loader.
cmake_minimum_required(VERSION 3.20)
set(CMAKE_C_STANDARD_REQUIRED YES)
set(CMAKE_C_EXTENSIONS NO)
set_property(GLOBAL PROPERTY CSTD iso9899:2011)

if(NOT DEFINED ATOMVM_DIR)
    set(ATOMVM_DIR $ENV{ATOMVM_DIR})
endif()
set(ATOMVM_ZEPHYR_ROOT ${ATOMVM_DIR}/src/platforms/zephyr)

set(CONF_FILE ${ATOMVM_ZEPHYR_ROOT}/prj.conf ${CMAKE_CURRENT_LIST_DIR}/prj.conf)

# Run precompiled riscv32 code from the packs (patches/atomvm/0004); BEAM-only modules still
# run on the emulator. The riscv32 precompile target uses double-precision floats.
set(AVM_ZEPHYR_PRECOMPILED ON CACHE BOOL "" FORCE)
set(AVM_USE_32BIT_FLOAT OFF CACHE BOOL "" FORCE)

find_package(Zephyr REQUIRED HINTS $ENV{ZEPHYR_BASE})
project(AtomVM LANGUAGES C)

include(${ATOMVM_ZEPHYR_ROOT}/cmake/AtomVMZephyrApp.cmake)

target_sources(app PRIVATE src/avm_loader.c)

# NIFs added by a repository that extends this one (REGISTER_NIF_COLLECTION in their sources)
if(DEFINED AVM_EXTRA_SOURCES)
    target_sources(app PRIVATE ${AVM_EXTRA_SOURCES})
endif()
```

## Kconfig
```
# AtomVM's own Kconfig menu, from the pinned checkout (ATOMVM_DIR, set by scripts/build_atomvm.sh)
mainmenu "AtomVM on Tang Primer 25K"

source "$(ATOMVM_DIR)/src/platforms/zephyr/Kconfig.atomvm"

menu "Tang Primer 25K AVM loader"

config TANG_AVM_STAGING_ADDRESS
    hex "SDRAM address scripts/load_app.py loads the application AVM pack to"
    default 0x41c00000

config TANG_AVM_FLASH_LIB_ADDRESS
    hex "Memory-mapped SPI flash address of the library AVM pack"
    default 0xa00000
    help
      SPI flash offset 0x200000 (scripts/flash.sh) in the 0x800000 flash window.

config TANG_AVM_FLASH_APP_ADDRESS
    hex "Memory-mapped SPI flash address of the application AVM pack"
    default 0xe00000
    help
      SPI flash offset 0x600000 (scripts/flash.sh) in the 0x800000 flash window.

endmenu

source "Kconfig.zephyr"
```

## prj.conf
```kconfig
# Tang Primer 25K / LiteX additions to AtomVM's src/platforms/zephyr/prj.conf

# AtomVM allocates with malloc(); the C library's arena takes all SDRAM left after the image
# (32 MB board, COMMON_LIBC_MALLOC_ARENA_SIZE default -1).

# No crypto engine, no network, no power management on this SoC
CONFIG_AVM_ENABLE_CRYPTO=n
CONFIG_PM=n
CONFIG_TASK_WDT=n
CONFIG_I2C=n
CONFIG_I2C_TARGET=n

# AVM packs in SDRAM slots, filled by src/avm_loader.c (board.overlay)
CONFIG_AVM_LIB_ADDRESS=0x41800000
CONFIG_AVM_LIB_SIZE=0x400000
CONFIG_AVM_APP_ADDRESS=0x41e00000
CONFIG_AVM_APP_SIZE=0x200000

# -O2: also selects picolibc's speed-optimised string functions (memcpy 49 -> 13 cycles/word,
# memset 25 -> 4 on this SoC, apps/membench); GC copying is a large part of run time.
CONFIG_SPEED_OPTIMIZATIONS=y
# 1 ms resolution for erlang:monotonic_time and timers (default tick is 10 ms)
CONFIG_SYS_CLOCK_TICKS_PER_SEC=1000
```

## board.overlay
```dts
/* SDRAM map (README): Zephyr + malloc arena get the first 24 MB, then the AVM pack slots
 * 0x41800000 library (4 MB), 0x41c00000 staging (2 MB), 0x41e00000 application (2 MB). */
&ram0 {
    reg = <0x40000000 0x1800000>;
};
```

## src/avm_loader.c
```c
/*
 * Fills the SDRAM slots AtomVM's main() reads the AVM packs from (docs/design.md section 3),
 * so that BEAM code runs from SDRAM rather than over the 1x SPI flash bus:
 *   library (atomvmlib): copied from the SPI flash;
 *   application: a pack serial-loaded into the staging slot (scripts/load_app.py) is moved
 *     and the staging copy invalidated, so a later reset does not rerun a stale upload;
 *     otherwise the pack in the SPI flash is copied (standalone boot).
 * A missing pack leaves the slot invalid; AtomVM then reports it.
 */
#include <string.h>
#include <zephyr/init.h>
#include <zephyr/sys/byteorder.h>
#include <zephyr/sys/printk.h>

#define AVM_HEADER "#!/usr/bin/env AtomVM\n"
#define AVM_HEADER_SIZE 24
#define AVM_END_SECTION_SIZE 16 /* size 0, flags, reserved, "end\0" */

/* Total size of the pack at p, or 0 if there is no valid pack within max bytes */
static size_t pack_size(const uint8_t *p, size_t max)
{
    if (memcmp(p, AVM_HEADER, sizeof(AVM_HEADER) - 1) != 0) {
        return 0;
    }
    size_t offset = AVM_HEADER_SIZE;
    while (offset + AVM_END_SECTION_SIZE <= max) {
        uint32_t section_size = sys_get_be32(p + offset);
        if (section_size == 0) {
            return offset + AVM_END_SECTION_SIZE;
        }
        if (section_size % 4 != 0 || section_size > max - offset) {
            return 0;
        }
        offset += section_size;
    }
    return 0;
}

/* Copies the pack at src to dst; returns its size, 0 (and dst invalidated) if there is none */
static size_t copy_pack(uint8_t *dst, const uint8_t *src, size_t max)
{
    size_t size = pack_size(src, max);
    if (size > 0) {
        memcpy(dst, src, size);
    } else {
        memset(dst, 0, AVM_HEADER_SIZE);
    }
    return size;
}

static int avm_loader_init(void)
{
    uint8_t *staging = (uint8_t *) CONFIG_TANG_AVM_STAGING_ADDRESS;
    size_t size;

    size = copy_pack((uint8_t *) CONFIG_AVM_LIB_ADDRESS,
        (const uint8_t *) CONFIG_TANG_AVM_FLASH_LIB_ADDRESS, CONFIG_AVM_LIB_SIZE);
    printk("avm_loader: library %u B from SPI flash\n", (unsigned) size);

    size = copy_pack((uint8_t *) CONFIG_AVM_APP_ADDRESS, staging, CONFIG_AVM_APP_SIZE);
    if (size > 0) {
        memset(staging, 0, AVM_HEADER_SIZE);
        printk("avm_loader: application %u B from the serial load\n", (unsigned) size);
        return 0;
    }
    size = copy_pack((uint8_t *) CONFIG_AVM_APP_ADDRESS,
        (const uint8_t *) CONFIG_TANG_AVM_FLASH_APP_ADDRESS, CONFIG_AVM_APP_SIZE);
    printk("avm_loader: application %u B from SPI flash\n", (unsigned) size);
    return 0;
}

SYS_INIT(avm_loader_init, APPLICATION, 0);
```
